## app/west.yml
```yaml
# Copyright (c) 2022-2023 Golioth, Inc.
# SPDX-License-Identifier: Apache-2.0

manifest:
  projects:
    - name: golioth
      path: modules/lib/golioth-firmware-sdk
      revision: main
      url: https://github.com/golioth/golioth-firmware-sdk.git
      submodules: true
      import:
        file: west-zephyr.yml
        path-prefix: deps
        name-allowlist:
          - zephyr
          - mbedtls
          - mcuboot
          - zcbor
          - hal_nxp

  self:
    path: app
```

## west.yml
```yaml
manifest:
  projects:
    - name: golioth
      path: modules/lib/golioth
      revision: v0.5.0
      url: https://github.com/golioth/golioth-zephyr-sdk
      west-commands: scripts/west-commands.yml
      import:
        file: west-zephyr.yml
        path-prefix: deps
        name-allowlist:
          - zephyr
          - hal_espressif
          - hal_infineon
          - hal_nordic
          - hal_nxp
          - mbedtls
          - mcuboot
          - qcbor
  self:
    path: app
    west-commands: utility/west-commands/west-commands.yml
```
